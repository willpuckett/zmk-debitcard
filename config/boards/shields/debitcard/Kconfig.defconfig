## config/boards/shields/debitcard/Kconfig.defconfig
```kconfig
# Copyright (c) 2020 The ZMK Contributors
# SPDX-License-Identifier: MIT

if SHIELD_DEBITCARD

config ZMK_BLE
	default y

config ZMK_USB
	default n

config ZMK_KEYBOARD_NAME
	default "debitcard"
endif
```

## config/boards/shields/debitcard/Kconfig.shield
```kconfig
# Copyright (c) 2020 The ZMK Contributors
# SPDX-License-Identifier: MIT
	
config SHIELD_DEBITCARD
	def_bool $(shields_list_contains,debitcard)
```

## config/boards/shields/piano/Kconfig.defconfig
```kconfig
# Copyright (c) 2020 The ZMK Contributors
# SPDX-License-Identifier: MIT

config ZMK_BLE
	default y

config ZMK_USB
	default y


if SHIELD_PUNI

config ZMK_KEYBOARD_NAME
	default "Puni"

endif
```

## config/west.yml
```yaml
# manifest:
#   remotes:
#     - name: benvallack
#       url-base: https://github.com/benvallack
#   projects:
#     - name: zmk
#       remote: benvallack
#       revision: repeatrollfix-tapdance-macro-mouse-dongle
#       import: app/west.yml
#   self:
#     path: config



manifest:
  remotes:
    - name: zmkfirmware
      url-base: https://github.com/zmkfirmware
    - name: infused-kim
      url-base: https://github.com/infused-kim
  projects:
    - name: zmk
      remote: zmkfirmware
      # revision: my-changes/split-encoder
      import: app/west.yml
  self:
    path: config
```
